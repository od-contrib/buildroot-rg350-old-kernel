## board/opendingux/Config.in
```kconfig
menu "OpenDingux packages"
comment "Emulators"
	source "$BR2_EXTERNAL_OPENDINGUX_PATH/package/pcsx4all/Config.in"
	source "$BR2_EXTERNAL_OPENDINGUX_PATH/package/pocketsnes/Config.in"

comment "Frontends"
	source "$BR2_EXTERNAL_OPENDINGUX_PATH/package/esoteric/Config.in"
	source "$BR2_EXTERNAL_OPENDINGUX_PATH/package/gmenu2x/Config.in"

comment "Games"
	source "$BR2_EXTERNAL_OPENDINGUX_PATH/package/blockattack/Config.in"
	source "$BR2_EXTERNAL_OPENDINGUX_PATH/package/gng/Config.in"
	source "$BR2_EXTERNAL_OPENDINGUX_PATH/package/hocoslamfy/Config.in"

comment "Libraries"
	source "$BR2_EXTERNAL_OPENDINGUX_PATH/package/allegro/Config.in"
	source "$BR2_EXTERNAL_OPENDINGUX_PATH/package/devil/Config.in"
	source "$BR2_EXTERNAL_OPENDINGUX_PATH/package/libini/Config.in"
	source "$BR2_EXTERNAL_OPENDINGUX_PATH/package/libopk/Config.in"
	source "$BR2_EXTERNAL_OPENDINGUX_PATH/package/libpng14/Config.in"
	source "$BR2_EXTERNAL_OPENDINGUX_PATH/package/libshake/Config.in"
	source "$BR2_EXTERNAL_OPENDINGUX_PATH/package/libxdgmime/Config.in"
	source "$BR2_EXTERNAL_OPENDINGUX_PATH/package/love2d/Config.in"
	source "$BR2_EXTERNAL_OPENDINGUX_PATH/package/utf8cpp/Config.in"

comment "System tools"
	source "$BR2_EXTERNAL_OPENDINGUX_PATH/package/dingux-commander/Config.in"
	source "$BR2_EXTERNAL_OPENDINGUX_PATH/package/od-network-config/Config.in"
	source "$BR2_EXTERNAL_OPENDINGUX_PATH/package/pwswd/Config.in"

comment "Utilities"
	source "$BR2_EXTERNAL_OPENDINGUX_PATH/package/bar/Config.in"

comment "Graphics drivers"
	source "$BR2_EXTERNAL_OPENDINGUX_PATH/package/etna_viv/Config.in"
	source "$BR2_EXTERNAL_OPENDINGUX_PATH/package/mesa3d-etna_viv/Config.in"

comment "Hardware handling"
	source "$BR2_EXTERNAL_OPENDINGUX_PATH/package/lowpowd/Config.in"
	source "$BR2_EXTERNAL_OPENDINGUX_PATH/package/unlockvt/Config.in"

endmenu
```

## board/opendingux/package/devilutionx/Config.in
```kconfig
config BR2_PACKAGE_DEVILUTIONX
	bool "DevilutionX"
	select BR2_PACKAGE_SDL
	select BR2_PACKAGE_SDL_IMAGE
	select BR2_PACKAGE_SDL_TTF
	select BR2_PACKAGE_SDL_MIXER
	help
	  Diablo 1.

	  https://github.com/diasurgical/devilutionX/

if BR2_PACKAGE_DEVILUTIONX
config BR2_PACKAGE_DEVILUTIONX_TARGET_PLATFORM
	string "Target platform (required)"
  help
	  One of the target platforms supported by DevilutionX.
endif
```

## board/opendingux/package/dingux-commander/Config.in
```kconfig
config BR2_PACKAGE_DINGUX_COMMANDER
	bool "DinguxCommander"
	select BR2_PACKAGE_SDL
	select BR2_PACKAGE_SDL_GFX
	select BR2_PACKAGE_SDL_IMAGE
	select BR2_PACKAGE_SDL_TTF
	help
	  Two-pane file manager in the style of Norton Commander.

	  https://github.com/glebm/rs97-commander/
```

## board/opendingux/package/esoteric/Config.in
```kconfig
config BR2_PACKAGE_ESOTERIC
	bool "esoteric"
	select BR2_PACKAGE_DEJAVU
	select BR2_PACKAGE_LIBPNG
	select BR2_PACKAGE_SDL
	select BR2_PACKAGE_SDL_TTF
	select BR2_PACKAGE_SDL_GFX
	help
	  Application menu for devices with a 320x240 screen and buttons.

	  Esoteric is a fork of GMenu2X developed for the ANBERNICRG-350 - (hence 350teric), released under the GNU GPL license v2.

	  https://github.com/podulator/gmenunx

if BR2_PACKAGE_ESOTERIC

config BR2_PACKAGE_ESOTERIC_PLATFORM
	string "Target platform"

endif
```

## board/opendingux/package/fluidsynth1/Config.in
```kconfig
config BR2_PACKAGE_FLUIDSYNTH1
	bool "fluidsynth1"
	depends on BR2_USE_WCHAR # libglib2
	depends on BR2_TOOLCHAIN_HAS_THREADS # libglib2
	depends on BR2_USE_MMU # libglib2
	select BR2_PACKAGE_LIBGLIB2
	help
	  Old version of libfluidsynth for binary backwards compatibility.

if BR2_PACKAGE_FLUIDSYNTH1

comment "Output support"

config BR2_PACKAGE_FLUIDSYNTH1_ALSA_LIB
	bool "alsa"
	default y
	depends on BR2_TOOLCHAIN_HAS_THREADS
	select BR2_PACKAGE_ALSA_LIB
	select BR2_PACKAGE_ALSA_LIB_RAWMIDI
	select BR2_PACKAGE_ALSA_LIB_SEQ
	help
	  Enable alsa support.

comment "alsa support needs a toolchain w/ threads"
	depends on !BR2_TOOLCHAIN_HAS_THREADS

config BR2_PACKAGE_FLUIDSYNTH1_JACK2
	bool "jack2"
	# See: https://sourceware.org/bugzilla/show_bug.cgi?id=19908
	depends on !BR2_TOOLCHAIN_EXTERNAL_CODESOURCERY_MIPS
	depends on BR2_TOOLCHAIN_HAS_THREADS # jack2
	depends on BR2_USE_MMU # jack2
	depends on BR2_INSTALL_LIBSTDCPP # jack2
	depends on !BR2_STATIC_LIBS # jack2
	depends on BR2_TOOLCHAIN_HAS_SYNC_4 # jack2
	select BR2_PACKAGE_JACK2
	help
	  Enable jack support.

comment "jack support needs a toolchain w/ dynamic library, threads, C++"
	depends on BR2_TOOLCHAIN_HAS_SYNC_4
	depends on BR2_USE_MMU
	depends on !BR2_TOOLCHAIN_EXTERNAL_CODESOURCERY_MIPS
	depends on BR2_STATIC_LIBS || !BR2_INSTALL_LIBSTDCPP || \
		!BR2_TOOLCHAIN_HAS_THREADS

config BR2_PACKAGE_FLUIDSYNTH1_LIBSNDFILE
	bool "libsndfile"
	select BR2_PACKAGE_LIBSNDFILE
	help
	  Enable libsndfile support, for writing output to WAV files.

config BR2_PACKAGE_FLUIDSYNTH1_PORTAUDIO
	bool "portaudio"
	depends on BR2_TOOLCHAIN_HAS_THREADS
	select BR2_PACKAGE_PORTAUDIO
	help
	  Enable portaudio support.

comment "portaudio support needs a toolchain w/ threads"
	depends on !BR2_TOOLCHAIN_HAS_THREADS

config BR2_PACKAGE_FLUIDSYNTH1_PULSEAUDIO
	bool "pulseaudio"
	# See: https://sourceware.org/bugzilla/show_bug.cgi?id=19908
	depends on !BR2_TOOLCHAIN_EXTERNAL_CODESOURCERY_MIPS
	depends on BR2_PACKAGE_PULSEAUDIO_HAS_ATOMIC # pulseaudio
	depends on BR2_USE_WCHAR # pulseaudio
	depends on BR2_TOOLCHAIN_HAS_THREADS # pulseaudio
	depends on !BR2_STATIC_LIBS # pulseaudio
	depends on BR2_USE_MMU # pulseaudio
	select BR2_PACKAGE_PULSEAUDIO
	help
	  Enable PulseAudio support.

comment "pulseaudio support needs a toolchain w/ dynamic library, wchar, threads"
	depends on BR2_USE_MMU
	depends on !BR2_TOOLCHAIN_EXTERNAL_CODESOURCERY_MIPS
	depends on BR2_PACKAGE_PULSEAUDIO_HAS_ATOMIC
	depends on BR2_STATIC_LIBS || !BR2_USE_MMU || !BR2_TOOLCHAIN_HAS_THREADS

comment "Misc options"

config BR2_PACKAGE_FLUIDSYNTH1_DBUS
	bool "dbus"
	depends on BR2_TOOLCHAIN_HAS_THREADS
	depends on BR2_USE_MMU
	select BR2_PACKAGE_DBUS
	help
	  Enable dbus support.

comment "dbus support needs a toolchain w/ threads"
	depends on BR2_USE_MMU
	depends on !BR2_TOOLCHAIN_HAS_THREADS

config BR2_PACKAGE_FLUIDSYNTH1_FLOATS
	bool "32-bit single precision float"
	help
	  Enable 32-bit single precision float support, instead of
	  64-bit double precision floats for DSP samples.

config BR2_PACKAGE_FLUIDSYNTH1_READLINE
	bool "readline"
	select BR2_PACKAGE_READLINE
	help
	  Enable readline support, for better line editing in FluidSynth
	  shell.

endif # BR2_PACKAGE_FLUIDSYNTH1

comment "fluidsynth needs a toolchain w/ threads, wchar"
	depends on BR2_USE_MMU
	depends on !BR2_USE_WCHAR || !BR2_TOOLCHAIN_HAS_THREADS
```

## board/opendingux/package/od-passwd-config/Config.in
```kconfig
config BR2_PACKAGE_OD_PASSWD_CONFIG
	bool "OpenDingux password configuration GUI"
	select BR2_PACKAGE_PYTHON
	select BR2_PACKAGE_PYTHON_PYGAME
	select BR2_PACKAGE_PYTHON_PYGAME_FONT
	help
	  This small application lets the user configure their password
	  on OpenDingux based systems.
```

## configs/rg350m_kernel_only_defconfig
```kconfig
BR2_mipsel=y
BR2_mips_xburst=y
BR2_MIPS_FP32_MODE_XX=y
# BR2_MIPS_SOFT_FLOAT is not set
BR2_OPTIMIZE_2=y
BR2_TOOLCHAIN_BUILDROOT_VENDOR="rg350"
BR2_TOOLCHAIN_BUILDROOT_LARGEFILE=y
BR2_TOOLCHAIN_BUILDROOT_INET_IPV6=y
BR2_TOOLCHAIN_BUILDROOT_WCHAR=y
BR2_TARGET_PLATFORM="rg350"
BR2_TARGET_DEVICE="rg350m"
BR2_KERNEL_HEADERS_3_12=y
BR2_UCLIBC_CONFIG="board/opendingux/gcw0/uclibc.config"
BR2_BINUTILS_EXTRA_CONFIG_OPTIONS="--enable-lto"
BR2_GCC_VERSION_5_X=y
BR2_EXTRA_GCC_CONFIG_OPTIONS="--enable-lto"
BR2_GCC_ENABLE_LTO=y
BR2_LINUX_KERNEL=y
BR2_LINUX_KERNEL_CUSTOM_TARBALL=y
BR2_LINUX_KERNEL_CUSTOM_TARBALL_LOCATION="https://github.com/od-contrib/rg350-old-kernel/archive/fa4be58f351e.tar.gz"
BR2_LINUX_KERNEL_USE_DEFCONFIG=y
BR2_LINUX_KERNEL_DEFCONFIG="rg350m"
BR2_LINUX_KERNEL_VMLINUZ_BIN=y
BR2_PACKAGE_BUSYBOX_CONFIG="board/opendingux/busybox.config"
BR2_PACKAGE_BUSYBOX_SHOW_OTHERS=y
```
